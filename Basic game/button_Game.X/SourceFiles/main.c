#define F_CPU 16000000UL

#include <avr/io.h>
#include <util/delay.h>

#define GPIO_PIN_0 (1 << 0) // 0b00000001
#define GPIO_PIN_1 (1 << 1) // 0b00000010
#define GPIO_PIN_2 (1 << 2) // 0b00000100
#define GPIO_PIN_3 (1 << 3) // 0b00001000

void GPIO_INIT(void)
{
    // PIN0 and PIN1  OUTPUTS
    DDRB |= (GPIO_PIN_0 | GPIO_PIN_1);
    
    // PIN2 and PIN3 INPUTS
    DDRB &= ~(GPIO_PIN_2 | GPIO_PIN_3);
    

}

void Green_Led(uint8_t status) // player 1
{
    if(status) PORTB |= GPIO_PIN_0;
    else       PORTB &= ~GPIO_PIN_0;
}

void Red_Led(uint8_t status) // player 2
{
    if(status) PORTB |= GPIO_PIN_1;
    else       PORTB &= ~GPIO_PIN_1;
}

// Global filter values
uint8_t player1_filter = 0;
uint8_t player2_filter = 0;

uint8_t read_player1(void)
{
    
    if(PINB & GPIO_PIN_2) {
        if(player1_filter < 10) player1_filter++;
    } 
   
    else {
        if(player1_filter > 0) player1_filter--;
    }
    

    if(player1_filter >= 10) return 1;
    return 0;
}

uint8_t read_player2(void)
{
    if(PINB & GPIO_PIN_3) {
        if(player2_filter < 10) player2_filter++;
    } else {
        if(player2_filter > 0) player2_filter--;
    }
    
    if(player2_filter >= 10) return 1;
    return 0;
}

int play_counter = 0;

void game_Playing(void)
{
    _delay_ms(1);
    play_counter++;
    
   
    if(play_counter > 200 && play_counter < 250)
    {
        if(read_player1())
        {
            Green_Led(1);
            Red_Led(0); // LED OFF
        }
        else if(read_player2())
        {
            Red_Led(1);
            Green_Led(0); // LED OFF
        }
    }
    else
    {
       
        Green_Led(1);
        Red_Led(1);
    }
    
    
    if(play_counter > 1000) {
        play_counter = 0; 
    }
}

int main(void)
{
    GPIO_INIT();
    
    while(1)
    {
        game_Playing();
    }
    
    return 0;
}