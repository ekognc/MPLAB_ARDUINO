#define F_CPU 16000000UL

#include<avr\io.h>
#include<util\delay.h>

  #define GPIO_PIN_0   0b00000001
    #define GPIO_PIN_1   0b00000010
    #define GPIO_PIN_2   0b00000100
    #define GPIO_PIN_3   0b00001000
    #define GPIO_PIN_4   0b00010000
    #define GPIO_PIN_5   0b00100000

typedef struct
{
    uint8_t push_flag;
    uint8_t free_flag;
    
    uint8_t pushed;
}button;

button button1;
button button2;
button button3;

void GPIO_Init() //cave style GPIO_Init
{
    DDRB&=~GPIO_PIN_0;
    DDRB&=~GPIO_PIN_1;
    DDRB&=~GPIO_PIN_2;
}


//it is just show
void set_button_Push(button* param_button)
{
    
    param_button->push_flag=1;
}

void set_button_Free(button* param_button)
{
    if(param_button->push_flag)
    {
    param_button->free_flag=1;
    }
}

void calculate_state_of_Button(button* param_button)
{
    if((param_button->push_flag)&&(param_button->free_flag))
    {
        param_button->pushed=1;
        param_button->push_flag=0;
        param_button->free_flag=0;
    }
    
}


void button_status_control()
{
    if(PINB&GPIO_PIN_0)
    {
        set_button_Push(&button1);
    }
    else
    {
        set_button_Free(&button1);
    }
    
    if(PINB&GPIO_PIN_1)
    {
        set_button_Push(&button2);
    }
    else
    {
        set_button_Free(&button2);
    }
    
        if(PINB&GPIO_PIN_2)
    {
        set_button_Push(&button3);
    }
    else
     {
            set_button_Free(&button3);
      }
    
    calculate_state_of_Button(&button1);
    calculate_state_of_Button(&button2);
    calculate_state_of_Button(&button3);
}



    uint16_t milis=0;
    uint8_t second=0;
    uint8_t minute=0;
    uint8_t clock=0;
void tick_Timer(button* param_button1,button* param_button2,button* param_button3)
{

    
    
    if(param_button1->pushed)
    {
        param_button1->pushed=0;
        second++;
    }
        if(param_button2->pushed)
    {
        param_button2->pushed=0;
        minute++;
    }
        if(param_button3->pushed)
    {
        param_button3->pushed=0;
        clock++;
    }
      
    if(milis>=1000)
    {
        second++;
        milis=0;
    }
    
    
    if(second>=60)
    {
        second=0;
        minute++;
    }
    if(minute>=60)
    {
        minute=0;
        clock++;
    }
    if(clock>=24)
    {
        clock=0;
    }
        
    
    
    _delay_ms(1);
    milis++;
    
    
}

int main()
{
    GPIO_Init();
    while(1)
    {
        button_status_control();
        tick_Timer(&button1,&button2,&button3);
    }
    return 0;
}