#define F_CPU 16000000UL

#include<avr\io.h>
#include<util\delay.h>

#define GPIO_PIN_0   0b00000001
#define GPIO_PIN_1   0b00000010
#define GPIO_PIN_2   0b00000100
#define GPIO_PIN_3   0b00001000
#define GPIO_PIN_4   0b00010000
#define GPIO_PIN_5   0b00100000
#define GPIO_PIN_6   0b01000000
#define GPIO_PIN_7   0b10000000
#define GPIO_PIN_ALL 0b11111111



void GPIO_Init()
{
    DDRB|=GPIO_PIN_ALL; //all out
    DDRD&=~GPIO_PIN_2; //P?n 2 as input
}


uint8_t Filter_Counter=0;
uint8_t Counter_Based_Filter() //it is basic counter based filter, it is actually work like a capacitor.
{
    uint8_t this_return=0;
    if(PIND&GPIO_PIN_2) //take all PORT D PINS and use & on GPIO_PIN_2 if it is 1 it means GPIO_PIN_2 is high
    {
        if(Filter_Counter<10) // if under 10 ++ until it is 10
            Filter_Counter++;
    }
    else
    {
        if(Filter_Counter>0) //if it is above 0 -- until it is 0
            Filter_Counter--;
    }
    
    if(Filter_Counter==10)
    {
        this_return=1; //if it is 10 return 1
    }
    else 
    {
        this_return =0; // if it is 0 return 0
    }
    
    return this_return;
}
uint8_t Input_controll()
{
    return Counter_Based_Filter();
}


void Select_OUTPUT(uint8_t param_select)  //hey from the cave again i am writing whoooole things under if and its love else
{
    if(param_select==0)
    {
        PORTB=GPIO_PIN_0;
    }
    else if(param_select==1)
    {
        PORTB=GPIO_PIN_1;
    }
    else if(param_select==2)
    {
        PORTB=GPIO_PIN_2;
    }
    else if(param_select==3)
    {
        PORTB=GPIO_PIN_3;
    }
    else if(param_select==4)
    {
        PORTB=GPIO_PIN_4;
    }
    else if(param_select==5)
    {
        PORTB=GPIO_PIN_5;
    }
    else if(param_select==6)
    {
        PORTB=GPIO_PIN_6;
    }
    else if(param_select==7)
    {
        PORTB=GPIO_PIN_7;
    }
    
}

uint8_t input_now=0;
uint8_t input_past=0;
uint8_t input_counter=0;
uint8_t first_start=0;
void Output_Action() //it makes output to use input counter 
{
    input_past=input_now;
    
    if(first_start==0) //there is first start because GPIO_PIN_0 must on in first cycle
    {
        if(first_start==0)
        {
            first_start++;
        }
        PORTB|=GPIO_PIN_0;
    }
    if(Input_controll())
    {
       input_now =1;
    }
    else
    {
        input_now=0;
    }
    
    if((input_past==1)&&(input_now==0))
    {
        input_counter++;
            
    if(input_counter>=8)
    {
        input_counter=0;
    }
        Select_OUTPUT(input_counter);
    }

    
}



int main(void)
{
    GPIO_Init();
    
    while(1)
    {
        Output_Action();
        _delay_ms(1);
    }
    
    return 0;
}